## build/Kconfig/arch/Kconfig
```kconfig
# Load Zephyr Arch Kconfig descriptions.
osource "/home/goaty/Desktop/Tech/zephyr/arch/rx/Kconfig"
osource "/home/goaty/Desktop/Tech/zephyr/arch/x86/Kconfig"
osource "/home/goaty/Desktop/Tech/zephyr/arch/xtensa/Kconfig"
osource "/home/goaty/Desktop/Tech/zephyr/arch/sparc/Kconfig"
osource "/home/goaty/Desktop/Tech/zephyr/arch/riscv/Kconfig"
osource "/home/goaty/Desktop/Tech/zephyr/arch/posix/Kconfig"
osource "/home/goaty/Desktop/Tech/zephyr/arch/mips/Kconfig"
osource "/home/goaty/Desktop/Tech/zephyr/arch/arm64/Kconfig"
osource "/home/goaty/Desktop/Tech/zephyr/arch/arm/Kconfig"
osource "/home/goaty/Desktop/Tech/zephyr/arch/arc/Kconfig"
```

## build/Kconfig/boards/Kconfig
```kconfig
# Load Zephyr board Kconfig descriptions.
osource "/home/goaty/Desktop/Tech/zephyr/boards/nordic/nrf9160dk/Kconfig"
config BOARD_REVISION_0_14_0
	def_bool y
```

## build/Kconfig/boards/Kconfig.nrf9160dk
```kconfig
# Load board Kconfig descriptions.
osource "/home/goaty/Desktop/Tech/zephyr/boards/nordic/nrf9160dk/Kconfig.nrf9160dk"
```

## build/Kconfig/soc/Kconfig.soc
```kconfig
# Load SoC Kconfig descriptions.
osource "/home/goaty/Desktop/Tech/zephyr/soc/xlnx/zynqmp/Kconfig.soc"
osource "/home/goaty/Desktop/Tech/zephyr/soc/xlnx/zynq7000/Kconfig.soc"
osource "/home/goaty/Desktop/Tech/zephyr/soc/xlnx/versalnet/Kconfig.soc"
osource "/home/goaty/Desktop/Tech/zephyr/soc/xlnx/versal2/Kconfig.soc"
osource "/home/goaty/Desktop/Tech/zephyr/soc/xen/Kconfig.soc"
osource "/home/goaty/Desktop/Tech/zephyr/soc/wch/ch32v/Kconfig.soc"
osource "/home/goaty/Desktop/Tech/zephyr/soc/ti/simplelink/Kconfig.soc"
osource "/home/goaty/Desktop/Tech/zephyr/soc/ti/mspm0/Kconfig.soc"
osource "/home/goaty/Desktop/Tech/zephyr/soc/ti/lm3s6965/Kconfig.soc"
osource "/home/goaty/Desktop/Tech/zephyr/soc/ti/k3/Kconfig.soc"
osource "/home/goaty/Desktop/Tech/zephyr/soc/telink/tlsr/Kconfig.soc"
osource "/home/goaty/Desktop/Tech/zephyr/soc/starfive/jh71xx/Kconfig.soc"
osource "/home/goaty/Desktop/Tech/zephyr/soc/st/stm32/Kconfig.soc"
osource "/home/goaty/Desktop/Tech/zephyr/soc/snps/qemu_arc/Kconfig.soc"
osource "/home/goaty/Desktop/Tech/zephyr/soc/snps/nsim/arc_v/Kconfig.soc"
osource "/home/goaty/Desktop/Tech/zephyr/soc/snps/nsim/arc_classic/Kconfig.soc"
osource "/home/goaty/Desktop/Tech/zephyr/soc/snps/hsdk4xd/Kconfig.soc"
osource "/home/goaty/Desktop/Tech/zephyr/soc/snps/hsdk/Kconfig.soc"
osource "/home/goaty/Desktop/Tech/zephyr/soc/snps/emsk/Kconfig.soc"
osource "/home/goaty/Desktop/Tech/zephyr/soc/snps/emsdp/Kconfig.soc"
osource "/home/goaty/Desktop/Tech/zephyr/soc/snps/arc_iot/Kconfig.soc"
osource "/home/goaty/Desktop/Tech/zephyr/soc/silabs/Kconfig.soc"
osource "/home/goaty/Desktop/Tech/zephyr/soc/sifive/sifive_freedom/Kconfig.soc"
osource "/home/goaty/Desktop/Tech/zephyr/soc/sensry/Kconfig.soc"
osource "/home/goaty/Desktop/Tech/zephyr/soc/rockchip/Kconfig.soc"
osource "/home/goaty/Desktop/Tech/zephyr/soc/renode/riscv_virtual/Kconfig.soc"
osource "/home/goaty/Desktop/Tech/zephyr/soc/renode/cortex_r8_virtual/Kconfig.soc"
osource "/home/goaty/Desktop/Tech/zephyr/soc/renesas/smartbond/Kconfig.soc"
osource "/home/goaty/Desktop/Tech/zephyr/soc/renesas/rz/Kconfig.soc"
osource "/home/goaty/Desktop/Tech/zephyr/soc/renesas/rx/Kconfig.soc"
osource "/home/goaty/Desktop/Tech/zephyr/soc/renesas/rcar/Kconfig.soc"
osource "/home/goaty/Desktop/Tech/zephyr/soc/renesas/ra/Kconfig.soc"
osource "/home/goaty/Desktop/Tech/zephyr/soc/realtek/ec/Kconfig.soc"
osource "/home/goaty/Desktop/Tech/zephyr/soc/raspberrypi/rpi_pico/Kconfig.soc"
osource "/home/goaty/Desktop/Tech/zephyr/soc/quicklogic/eos_s3/Kconfig.soc"
osource "/home/goaty/Desktop/Tech/zephyr/soc/qemu/virt_riscv/Kconfig.soc"
osource "/home/goaty/Desktop/Tech/zephyr/soc/qemu/malta/Kconfig.soc"
osource "/home/goaty/Desktop/Tech/zephyr/soc/openisa/rv32m1/Kconfig.soc"
osource "/home/goaty/Desktop/Tech/zephyr/soc/openhwgroup/cva6/Kconfig.soc"
osource "/home/goaty/Desktop/Tech/zephyr/soc/oct/osd32mp15x/Kconfig.soc"
osource "/home/goaty/Desktop/Tech/zephyr/soc/nxp/s32/Kconfig.soc"
osource "/home/goaty/Desktop/Tech/zephyr/soc/nxp/rw/Kconfig.soc"
osource "/home/goaty/Desktop/Tech/zephyr/soc/nxp/mcx/Kconfig.soc"
osource "/home/goaty/Desktop/Tech/zephyr/soc/nxp/lpc/Kconfig.soc"
osource "/home/goaty/Desktop/Tech/zephyr/soc/nxp/layerscape/Kconfig.soc"
osource "/home/goaty/Desktop/Tech/zephyr/soc/nxp/kinetis/Kconfig.soc"
osource "/home/goaty/Desktop/Tech/zephyr/soc/nxp/imxrt/Kconfig.soc"
osource "/home/goaty/Desktop/Tech/zephyr/soc/nxp/imx/Kconfig.soc"
osource "/home/goaty/Desktop/Tech/zephyr/soc/nuvoton/numicro/Kconfig.soc"
osource "/home/goaty/Desktop/Tech/zephyr/soc/nuvoton/numaker/Kconfig.soc"
osource "/home/goaty/Desktop/Tech/zephyr/soc/nuvoton/npcx/Kconfig.soc"
osource "/home/goaty/Desktop/Tech/zephyr/soc/nuvoton/npcm/Kconfig.soc"
osource "/home/goaty/Desktop/Tech/zephyr/soc/nordic/Kconfig.soc"
osource "/home/goaty/Desktop/Tech/zephyr/soc/neorv32/Kconfig.soc"
osource "/home/goaty/Desktop/Tech/zephyr/soc/native/inf_clock/Kconfig.soc"
osource "/home/goaty/Desktop/Tech/zephyr/soc/microchip/sam/Kconfig.soc"
osource "/home/goaty/Desktop/Tech/zephyr/soc/microchip/sam/sam_d5x_e5x/Kconfig.soc"
osource "/home/goaty/Desktop/Tech/zephyr/soc/microchip/miv/Kconfig.soc"
osource "/home/goaty/Desktop/Tech/zephyr/soc/microchip/mec/Kconfig.soc"
osource "/home/goaty/Desktop/Tech/zephyr/soc/mediatek/mt8xxx/Kconfig.soc"
osource "/home/goaty/Desktop/Tech/zephyr/soc/lowrisc/opentitan/Kconfig.soc"
osource "/home/goaty/Desktop/Tech/zephyr/soc/litex/litex_vexriscv/Kconfig.soc"
osource "/home/goaty/Desktop/Tech/zephyr/soc/ite/ec/Kconfig.soc"
osource "/home/goaty/Desktop/Tech/zephyr/soc/intel/raptor_lake/Kconfig.soc"
osource "/home/goaty/Desktop/Tech/zephyr/soc/intel/panther_lake/Kconfig.soc"
osource "/home/goaty/Desktop/Tech/zephyr/soc/intel/lakemont/Kconfig.soc"
osource "/home/goaty/Desktop/Tech/zephyr/soc/intel/intel_socfpga_std/Kconfig.soc"
osource "/home/goaty/Desktop/Tech/zephyr/soc/intel/intel_socfpga/Kconfig.soc"
osource "/home/goaty/Desktop/Tech/zephyr/soc/intel/intel_niosv/Kconfig.soc"
osource "/home/goaty/Desktop/Tech/zephyr/soc/intel/intel_ish/Kconfig.soc"
osource "/home/goaty/Desktop/Tech/zephyr/soc/intel/intel_adsp/Kconfig.soc"
osource "/home/goaty/Desktop/Tech/zephyr/soc/intel/elkhart_lake/Kconfig.soc"
osource "/home/goaty/Desktop/Tech/zephyr/soc/intel/atom/Kconfig.soc"
osource "/home/goaty/Desktop/Tech/zephyr/soc/intel/apollo_lake/Kconfig.soc"
osource "/home/goaty/Desktop/Tech/zephyr/soc/intel/alder_lake/Kconfig.soc"
osource "/home/goaty/Desktop/Tech/zephyr/soc/infineon/cat3/Kconfig.soc"
osource "/home/goaty/Desktop/Tech/zephyr/soc/infineon/cat1c/Kconfig.soc"
osource "/home/goaty/Desktop/Tech/zephyr/soc/infineon/cat1b/Kconfig.soc"
osource "/home/goaty/Desktop/Tech/zephyr/soc/infineon/cat1a/Kconfig.soc"
osource "/home/goaty/Desktop/Tech/zephyr/soc/gd/gd32/Kconfig.soc"
osource "/home/goaty/Desktop/Tech/zephyr/soc/gaisler/leon3/Kconfig.soc"
osource "/home/goaty/Desktop/Tech/zephyr/soc/gaisler/gr716a/Kconfig.soc"
osource "/home/goaty/Desktop/Tech/zephyr/soc/espressif/Kconfig.soc"
osource "/home/goaty/Desktop/Tech/zephyr/soc/ene/kb1200/Kconfig.soc"
osource "/home/goaty/Desktop/Tech/zephyr/soc/ene/kb106x/Kconfig.soc"
osource "/home/goaty/Desktop/Tech/zephyr/soc/efinix/sapphire/Kconfig.soc"
osource "/home/goaty/Desktop/Tech/zephyr/soc/cdns/xtensa_sample_controller/Kconfig.soc"
osource "/home/goaty/Desktop/Tech/zephyr/soc/cdns/sample_controller32/Kconfig.soc"
osource "/home/goaty/Desktop/Tech/zephyr/soc/cdns/dc233c/Kconfig.soc"
osource "/home/goaty/Desktop/Tech/zephyr/soc/brcm/bcmvk/Kconfig.soc"
osource "/home/goaty/Desktop/Tech/zephyr/soc/brcm/bcm2712/Kconfig.soc"
osource "/home/goaty/Desktop/Tech/zephyr/soc/brcm/bcm2711/Kconfig.soc"
osource "/home/goaty/Desktop/Tech/zephyr/soc/bflb/Kconfig.soc"
osource "/home/goaty/Desktop/Tech/zephyr/soc/atmel/sam0/Kconfig.soc"
osource "/home/goaty/Desktop/Tech/zephyr/soc/atmel/sam/Kconfig.soc"
osource "/home/goaty/Desktop/Tech/zephyr/soc/aspeed/Kconfig.soc"
osource "/home/goaty/Desktop/Tech/zephyr/soc/arm/Kconfig.soc"
osource "/home/goaty/Desktop/Tech/zephyr/soc/arm/beetle/Kconfig.soc"
osource "/home/goaty/Desktop/Tech/zephyr/soc/antmicro/myra/Kconfig.soc"
osource "/home/goaty/Desktop/Tech/zephyr/soc/andestech/Kconfig.soc"
osource "/home/goaty/Desktop/Tech/zephyr/soc/amd/acp_6_0/Kconfig.soc"
osource "/home/goaty/Desktop/Tech/zephyr/soc/ambiq/Kconfig.soc"
osource "/home/goaty/Desktop/Tech/zephyr/soc/aesc/Kconfig.soc"
osource "/home/goaty/Desktop/Tech/zephyr/soc/adi/max32/Kconfig.soc"
osource "/home/goaty/Desktop/Tech/nrf/soc/sercomm/nrf91/Kconfig.soc"
osource "/home/goaty/Desktop/Tech/nrf/soc/nordic/Kconfig.soc"
```
