## build/Kconfig/soc/Kconfig.sysbuild
```kconfig
# Load Sysbuild SoC Kconfig descriptions.
osource "/home/goaty/Desktop/Tech/zephyr/soc/xlnx/zynqmp/Kconfig.sysbuild"
osource "/home/goaty/Desktop/Tech/zephyr/soc/xlnx/zynq7000/Kconfig.sysbuild"
osource "/home/goaty/Desktop/Tech/zephyr/soc/xlnx/versalnet/Kconfig.sysbuild"
osource "/home/goaty/Desktop/Tech/zephyr/soc/xlnx/versal2/Kconfig.sysbuild"
osource "/home/goaty/Desktop/Tech/zephyr/soc/xen/Kconfig.sysbuild"
osource "/home/goaty/Desktop/Tech/zephyr/soc/wch/ch32v/Kconfig.sysbuild"
osource "/home/goaty/Desktop/Tech/zephyr/soc/ti/simplelink/Kconfig.sysbuild"
osource "/home/goaty/Desktop/Tech/zephyr/soc/ti/mspm0/Kconfig.sysbuild"
osource "/home/goaty/Desktop/Tech/zephyr/soc/ti/lm3s6965/Kconfig.sysbuild"
osource "/home/goaty/Desktop/Tech/zephyr/soc/ti/k3/Kconfig.sysbuild"
osource "/home/goaty/Desktop/Tech/zephyr/soc/telink/tlsr/Kconfig.sysbuild"
osource "/home/goaty/Desktop/Tech/zephyr/soc/starfive/jh71xx/Kconfig.sysbuild"
osource "/home/goaty/Desktop/Tech/zephyr/soc/st/stm32/Kconfig.sysbuild"
osource "/home/goaty/Desktop/Tech/zephyr/soc/snps/qemu_arc/Kconfig.sysbuild"
osource "/home/goaty/Desktop/Tech/zephyr/soc/snps/nsim/arc_v/Kconfig.sysbuild"
osource "/home/goaty/Desktop/Tech/zephyr/soc/snps/nsim/arc_classic/Kconfig.sysbuild"
osource "/home/goaty/Desktop/Tech/zephyr/soc/snps/hsdk4xd/Kconfig.sysbuild"
osource "/home/goaty/Desktop/Tech/zephyr/soc/snps/hsdk/Kconfig.sysbuild"
osource "/home/goaty/Desktop/Tech/zephyr/soc/snps/emsk/Kconfig.sysbuild"
osource "/home/goaty/Desktop/Tech/zephyr/soc/snps/emsdp/Kconfig.sysbuild"
osource "/home/goaty/Desktop/Tech/zephyr/soc/snps/arc_iot/Kconfig.sysbuild"
osource "/home/goaty/Desktop/Tech/zephyr/soc/silabs/Kconfig.sysbuild"
osource "/home/goaty/Desktop/Tech/zephyr/soc/sifive/sifive_freedom/Kconfig.sysbuild"
osource "/home/goaty/Desktop/Tech/zephyr/soc/sensry/Kconfig.sysbuild"
osource "/home/goaty/Desktop/Tech/zephyr/soc/rockchip/Kconfig.sysbuild"
osource "/home/goaty/Desktop/Tech/zephyr/soc/renode/riscv_virtual/Kconfig.sysbuild"
osource "/home/goaty/Desktop/Tech/zephyr/soc/renode/cortex_r8_virtual/Kconfig.sysbuild"
osource "/home/goaty/Desktop/Tech/zephyr/soc/renesas/smartbond/Kconfig.sysbuild"
osource "/home/goaty/Desktop/Tech/zephyr/soc/renesas/rz/Kconfig.sysbuild"
osource "/home/goaty/Desktop/Tech/zephyr/soc/renesas/rx/Kconfig.sysbuild"
osource "/home/goaty/Desktop/Tech/zephyr/soc/renesas/rcar/Kconfig.sysbuild"
osource "/home/goaty/Desktop/Tech/zephyr/soc/renesas/ra/Kconfig.sysbuild"
osource "/home/goaty/Desktop/Tech/zephyr/soc/realtek/ec/Kconfig.sysbuild"
osource "/home/goaty/Desktop/Tech/zephyr/soc/raspberrypi/rpi_pico/Kconfig.sysbuild"
osource "/home/goaty/Desktop/Tech/zephyr/soc/quicklogic/eos_s3/Kconfig.sysbuild"
osource "/home/goaty/Desktop/Tech/zephyr/soc/qemu/virt_riscv/Kconfig.sysbuild"
osource "/home/goaty/Desktop/Tech/zephyr/soc/qemu/malta/Kconfig.sysbuild"
osource "/home/goaty/Desktop/Tech/zephyr/soc/openisa/rv32m1/Kconfig.sysbuild"
osource "/home/goaty/Desktop/Tech/zephyr/soc/openhwgroup/cva6/Kconfig.sysbuild"
osource "/home/goaty/Desktop/Tech/zephyr/soc/oct/osd32mp15x/Kconfig.sysbuild"
osource "/home/goaty/Desktop/Tech/zephyr/soc/nxp/s32/Kconfig.sysbuild"
osource "/home/goaty/Desktop/Tech/zephyr/soc/nxp/rw/Kconfig.sysbuild"
osource "/home/goaty/Desktop/Tech/zephyr/soc/nxp/mcx/Kconfig.sysbuild"
osource "/home/goaty/Desktop/Tech/zephyr/soc/nxp/lpc/Kconfig.sysbuild"
osource "/home/goaty/Desktop/Tech/zephyr/soc/nxp/layerscape/Kconfig.sysbuild"
osource "/home/goaty/Desktop/Tech/zephyr/soc/nxp/kinetis/Kconfig.sysbuild"
osource "/home/goaty/Desktop/Tech/zephyr/soc/nxp/imxrt/Kconfig.sysbuild"
osource "/home/goaty/Desktop/Tech/zephyr/soc/nxp/imx/Kconfig.sysbuild"
osource "/home/goaty/Desktop/Tech/zephyr/soc/nuvoton/numicro/Kconfig.sysbuild"
osource "/home/goaty/Desktop/Tech/zephyr/soc/nuvoton/numaker/Kconfig.sysbuild"
osource "/home/goaty/Desktop/Tech/zephyr/soc/nuvoton/npcx/Kconfig.sysbuild"
osource "/home/goaty/Desktop/Tech/zephyr/soc/nuvoton/npcm/Kconfig.sysbuild"
osource "/home/goaty/Desktop/Tech/zephyr/soc/nordic/Kconfig.sysbuild"
osource "/home/goaty/Desktop/Tech/zephyr/soc/neorv32/Kconfig.sysbuild"
osource "/home/goaty/Desktop/Tech/zephyr/soc/native/inf_clock/Kconfig.sysbuild"
osource "/home/goaty/Desktop/Tech/zephyr/soc/microchip/sam/Kconfig.sysbuild"
osource "/home/goaty/Desktop/Tech/zephyr/soc/microchip/sam/sam_d5x_e5x/Kconfig.sysbuild"
osource "/home/goaty/Desktop/Tech/zephyr/soc/microchip/miv/Kconfig.sysbuild"
osource "/home/goaty/Desktop/Tech/zephyr/soc/microchip/mec/Kconfig.sysbuild"
osource "/home/goaty/Desktop/Tech/zephyr/soc/mediatek/mt8xxx/Kconfig.sysbuild"
osource "/home/goaty/Desktop/Tech/zephyr/soc/lowrisc/opentitan/Kconfig.sysbuild"
osource "/home/goaty/Desktop/Tech/zephyr/soc/litex/litex_vexriscv/Kconfig.sysbuild"
osource "/home/goaty/Desktop/Tech/zephyr/soc/ite/ec/Kconfig.sysbuild"
osource "/home/goaty/Desktop/Tech/zephyr/soc/intel/raptor_lake/Kconfig.sysbuild"
osource "/home/goaty/Desktop/Tech/zephyr/soc/intel/panther_lake/Kconfig.sysbuild"
osource "/home/goaty/Desktop/Tech/zephyr/soc/intel/lakemont/Kconfig.sysbuild"
osource "/home/goaty/Desktop/Tech/zephyr/soc/intel/intel_socfpga_std/Kconfig.sysbuild"
osource "/home/goaty/Desktop/Tech/zephyr/soc/intel/intel_socfpga/Kconfig.sysbuild"
osource "/home/goaty/Desktop/Tech/zephyr/soc/intel/intel_niosv/Kconfig.sysbuild"
osource "/home/goaty/Desktop/Tech/zephyr/soc/intel/intel_ish/Kconfig.sysbuild"
osource "/home/goaty/Desktop/Tech/zephyr/soc/intel/intel_adsp/Kconfig.sysbuild"
osource "/home/goaty/Desktop/Tech/zephyr/soc/intel/elkhart_lake/Kconfig.sysbuild"
osource "/home/goaty/Desktop/Tech/zephyr/soc/intel/atom/Kconfig.sysbuild"
osource "/home/goaty/Desktop/Tech/zephyr/soc/intel/apollo_lake/Kconfig.sysbuild"
osource "/home/goaty/Desktop/Tech/zephyr/soc/intel/alder_lake/Kconfig.sysbuild"
osource "/home/goaty/Desktop/Tech/zephyr/soc/infineon/cat3/Kconfig.sysbuild"
osource "/home/goaty/Desktop/Tech/zephyr/soc/infineon/cat1c/Kconfig.sysbuild"
osource "/home/goaty/Desktop/Tech/zephyr/soc/infineon/cat1b/Kconfig.sysbuild"
osource "/home/goaty/Desktop/Tech/zephyr/soc/infineon/cat1a/Kconfig.sysbuild"
osource "/home/goaty/Desktop/Tech/zephyr/soc/gd/gd32/Kconfig.sysbuild"
osource "/home/goaty/Desktop/Tech/zephyr/soc/gaisler/leon3/Kconfig.sysbuild"
osource "/home/goaty/Desktop/Tech/zephyr/soc/gaisler/gr716a/Kconfig.sysbuild"
osource "/home/goaty/Desktop/Tech/zephyr/soc/espressif/Kconfig.sysbuild"
osource "/home/goaty/Desktop/Tech/zephyr/soc/ene/kb1200/Kconfig.sysbuild"
osource "/home/goaty/Desktop/Tech/zephyr/soc/ene/kb106x/Kconfig.sysbuild"
osource "/home/goaty/Desktop/Tech/zephyr/soc/efinix/sapphire/Kconfig.sysbuild"
osource "/home/goaty/Desktop/Tech/zephyr/soc/cdns/xtensa_sample_controller/Kconfig.sysbuild"
osource "/home/goaty/Desktop/Tech/zephyr/soc/cdns/sample_controller32/Kconfig.sysbuild"
osource "/home/goaty/Desktop/Tech/zephyr/soc/cdns/dc233c/Kconfig.sysbuild"
osource "/home/goaty/Desktop/Tech/zephyr/soc/brcm/bcmvk/Kconfig.sysbuild"
osource "/home/goaty/Desktop/Tech/zephyr/soc/brcm/bcm2712/Kconfig.sysbuild"
osource "/home/goaty/Desktop/Tech/zephyr/soc/brcm/bcm2711/Kconfig.sysbuild"
osource "/home/goaty/Desktop/Tech/zephyr/soc/bflb/Kconfig.sysbuild"
osource "/home/goaty/Desktop/Tech/zephyr/soc/atmel/sam0/Kconfig.sysbuild"
osource "/home/goaty/Desktop/Tech/zephyr/soc/atmel/sam/Kconfig.sysbuild"
osource "/home/goaty/Desktop/Tech/zephyr/soc/aspeed/Kconfig.sysbuild"
osource "/home/goaty/Desktop/Tech/zephyr/soc/arm/Kconfig.sysbuild"
osource "/home/goaty/Desktop/Tech/zephyr/soc/arm/beetle/Kconfig.sysbuild"
osource "/home/goaty/Desktop/Tech/zephyr/soc/antmicro/myra/Kconfig.sysbuild"
osource "/home/goaty/Desktop/Tech/zephyr/soc/andestech/Kconfig.sysbuild"
osource "/home/goaty/Desktop/Tech/zephyr/soc/amd/acp_6_0/Kconfig.sysbuild"
osource "/home/goaty/Desktop/Tech/zephyr/soc/ambiq/Kconfig.sysbuild"
osource "/home/goaty/Desktop/Tech/zephyr/soc/aesc/Kconfig.sysbuild"
osource "/home/goaty/Desktop/Tech/zephyr/soc/adi/max32/Kconfig.sysbuild"
osource "/home/goaty/Desktop/Tech/nrf/soc/sercomm/nrf91/Kconfig.sysbuild"
osource "/home/goaty/Desktop/Tech/nrf/soc/nordic/Kconfig.sysbuild"
```

## build/cellular-device/Kconfig/boards/Kconfig.defconfig
```kconfig
# Load Zephyr board defconfig descriptions.
osource "/home/goaty/Desktop/Tech/zephyr/boards/nordic/nrf9160dk/Kconfig.defconfig"
```

## build/cellular-device/Kconfig/boards/Kconfig.sysbuild
```kconfig
# Load Sysbuild board Kconfig descriptions.
osource "/home/goaty/Desktop/Tech/zephyr/boards/nordic/nrf9160dk/Kconfig.sysbuild"
```

## build/cellular-device/Kconfig/soc/Kconfig
```kconfig
# Load Zephyr SoC Kconfig descriptions.
osource "/home/goaty/Desktop/Tech/zephyr/soc/xlnx/zynqmp/Kconfig"
osource "/home/goaty/Desktop/Tech/zephyr/soc/xlnx/zynq7000/Kconfig"
osource "/home/goaty/Desktop/Tech/zephyr/soc/xlnx/versalnet/Kconfig"
osource "/home/goaty/Desktop/Tech/zephyr/soc/xlnx/versal2/Kconfig"
osource "/home/goaty/Desktop/Tech/zephyr/soc/xen/Kconfig"
osource "/home/goaty/Desktop/Tech/zephyr/soc/wch/ch32v/Kconfig"
osource "/home/goaty/Desktop/Tech/zephyr/soc/ti/simplelink/Kconfig"
osource "/home/goaty/Desktop/Tech/zephyr/soc/ti/mspm0/Kconfig"
osource "/home/goaty/Desktop/Tech/zephyr/soc/ti/lm3s6965/Kconfig"
osource "/home/goaty/Desktop/Tech/zephyr/soc/ti/k3/Kconfig"
osource "/home/goaty/Desktop/Tech/zephyr/soc/telink/tlsr/Kconfig"
osource "/home/goaty/Desktop/Tech/zephyr/soc/starfive/jh71xx/Kconfig"
osource "/home/goaty/Desktop/Tech/zephyr/soc/st/stm32/Kconfig"
osource "/home/goaty/Desktop/Tech/zephyr/soc/snps/qemu_arc/Kconfig"
osource "/home/goaty/Desktop/Tech/zephyr/soc/snps/nsim/arc_v/Kconfig"
osource "/home/goaty/Desktop/Tech/zephyr/soc/snps/nsim/arc_classic/Kconfig"
osource "/home/goaty/Desktop/Tech/zephyr/soc/snps/hsdk4xd/Kconfig"
osource "/home/goaty/Desktop/Tech/zephyr/soc/snps/hsdk/Kconfig"
osource "/home/goaty/Desktop/Tech/zephyr/soc/snps/emsk/Kconfig"
osource "/home/goaty/Desktop/Tech/zephyr/soc/snps/emsdp/Kconfig"
osource "/home/goaty/Desktop/Tech/zephyr/soc/snps/arc_iot/Kconfig"
osource "/home/goaty/Desktop/Tech/zephyr/soc/silabs/Kconfig"
osource "/home/goaty/Desktop/Tech/zephyr/soc/sifive/sifive_freedom/Kconfig"
osource "/home/goaty/Desktop/Tech/zephyr/soc/sensry/Kconfig"
osource "/home/goaty/Desktop/Tech/zephyr/soc/rockchip/Kconfig"
osource "/home/goaty/Desktop/Tech/zephyr/soc/renode/riscv_virtual/Kconfig"
osource "/home/goaty/Desktop/Tech/zephyr/soc/renode/cortex_r8_virtual/Kconfig"
osource "/home/goaty/Desktop/Tech/zephyr/soc/renesas/smartbond/Kconfig"
osource "/home/goaty/Desktop/Tech/zephyr/soc/renesas/rz/Kconfig"
osource "/home/goaty/Desktop/Tech/zephyr/soc/renesas/rx/Kconfig"
osource "/home/goaty/Desktop/Tech/zephyr/soc/renesas/rcar/Kconfig"
osource "/home/goaty/Desktop/Tech/zephyr/soc/renesas/ra/Kconfig"
osource "/home/goaty/Desktop/Tech/zephyr/soc/realtek/ec/Kconfig"
osource "/home/goaty/Desktop/Tech/zephyr/soc/raspberrypi/rpi_pico/Kconfig"
osource "/home/goaty/Desktop/Tech/zephyr/soc/quicklogic/eos_s3/Kconfig"
osource "/home/goaty/Desktop/Tech/zephyr/soc/qemu/virt_riscv/Kconfig"
osource "/home/goaty/Desktop/Tech/zephyr/soc/qemu/malta/Kconfig"
osource "/home/goaty/Desktop/Tech/zephyr/soc/openisa/rv32m1/Kconfig"
osource "/home/goaty/Desktop/Tech/zephyr/soc/openhwgroup/cva6/Kconfig"
osource "/home/goaty/Desktop/Tech/zephyr/soc/oct/osd32mp15x/Kconfig"
osource "/home/goaty/Desktop/Tech/zephyr/soc/nxp/s32/Kconfig"
osource "/home/goaty/Desktop/Tech/zephyr/soc/nxp/rw/Kconfig"
osource "/home/goaty/Desktop/Tech/zephyr/soc/nxp/mcx/Kconfig"
osource "/home/goaty/Desktop/Tech/zephyr/soc/nxp/lpc/Kconfig"
osource "/home/goaty/Desktop/Tech/zephyr/soc/nxp/layerscape/Kconfig"
osource "/home/goaty/Desktop/Tech/zephyr/soc/nxp/kinetis/Kconfig"
osource "/home/goaty/Desktop/Tech/zephyr/soc/nxp/imxrt/Kconfig"
osource "/home/goaty/Desktop/Tech/zephyr/soc/nxp/imx/Kconfig"
osource "/home/goaty/Desktop/Tech/zephyr/soc/nuvoton/numicro/Kconfig"
osource "/home/goaty/Desktop/Tech/zephyr/soc/nuvoton/numaker/Kconfig"
osource "/home/goaty/Desktop/Tech/zephyr/soc/nuvoton/npcx/Kconfig"
osource "/home/goaty/Desktop/Tech/zephyr/soc/nuvoton/npcm/Kconfig"
osource "/home/goaty/Desktop/Tech/zephyr/soc/nordic/Kconfig"
osource "/home/goaty/Desktop/Tech/zephyr/soc/neorv32/Kconfig"
osource "/home/goaty/Desktop/Tech/zephyr/soc/native/inf_clock/Kconfig"
osource "/home/goaty/Desktop/Tech/zephyr/soc/microchip/sam/Kconfig"
osource "/home/goaty/Desktop/Tech/zephyr/soc/microchip/sam/sam_d5x_e5x/Kconfig"
osource "/home/goaty/Desktop/Tech/zephyr/soc/microchip/miv/Kconfig"
osource "/home/goaty/Desktop/Tech/zephyr/soc/microchip/mec/Kconfig"
osource "/home/goaty/Desktop/Tech/zephyr/soc/mediatek/mt8xxx/Kconfig"
osource "/home/goaty/Desktop/Tech/zephyr/soc/lowrisc/opentitan/Kconfig"
osource "/home/goaty/Desktop/Tech/zephyr/soc/litex/litex_vexriscv/Kconfig"
osource "/home/goaty/Desktop/Tech/zephyr/soc/ite/ec/Kconfig"
osource "/home/goaty/Desktop/Tech/zephyr/soc/intel/raptor_lake/Kconfig"
osource "/home/goaty/Desktop/Tech/zephyr/soc/intel/panther_lake/Kconfig"
osource "/home/goaty/Desktop/Tech/zephyr/soc/intel/lakemont/Kconfig"
osource "/home/goaty/Desktop/Tech/zephyr/soc/intel/intel_socfpga_std/Kconfig"
osource "/home/goaty/Desktop/Tech/zephyr/soc/intel/intel_socfpga/Kconfig"
osource "/home/goaty/Desktop/Tech/zephyr/soc/intel/intel_niosv/Kconfig"
osource "/home/goaty/Desktop/Tech/zephyr/soc/intel/intel_ish/Kconfig"
osource "/home/goaty/Desktop/Tech/zephyr/soc/intel/intel_adsp/Kconfig"
osource "/home/goaty/Desktop/Tech/zephyr/soc/intel/elkhart_lake/Kconfig"
osource "/home/goaty/Desktop/Tech/zephyr/soc/intel/atom/Kconfig"
osource "/home/goaty/Desktop/Tech/zephyr/soc/intel/apollo_lake/Kconfig"
osource "/home/goaty/Desktop/Tech/zephyr/soc/intel/alder_lake/Kconfig"
osource "/home/goaty/Desktop/Tech/zephyr/soc/infineon/cat3/Kconfig"
osource "/home/goaty/Desktop/Tech/zephyr/soc/infineon/cat1c/Kconfig"
osource "/home/goaty/Desktop/Tech/zephyr/soc/infineon/cat1b/Kconfig"
osource "/home/goaty/Desktop/Tech/zephyr/soc/infineon/cat1a/Kconfig"
osource "/home/goaty/Desktop/Tech/zephyr/soc/gd/gd32/Kconfig"
osource "/home/goaty/Desktop/Tech/zephyr/soc/gaisler/leon3/Kconfig"
osource "/home/goaty/Desktop/Tech/zephyr/soc/gaisler/gr716a/Kconfig"
osource "/home/goaty/Desktop/Tech/zephyr/soc/espressif/Kconfig"
osource "/home/goaty/Desktop/Tech/zephyr/soc/ene/kb1200/Kconfig"
osource "/home/goaty/Desktop/Tech/zephyr/soc/ene/kb106x/Kconfig"
osource "/home/goaty/Desktop/Tech/zephyr/soc/efinix/sapphire/Kconfig"
osource "/home/goaty/Desktop/Tech/zephyr/soc/cdns/xtensa_sample_controller/Kconfig"
osource "/home/goaty/Desktop/Tech/zephyr/soc/cdns/sample_controller32/Kconfig"
osource "/home/goaty/Desktop/Tech/zephyr/soc/cdns/dc233c/Kconfig"
osource "/home/goaty/Desktop/Tech/zephyr/soc/brcm/bcmvk/Kconfig"
osource "/home/goaty/Desktop/Tech/zephyr/soc/brcm/bcm2712/Kconfig"
osource "/home/goaty/Desktop/Tech/zephyr/soc/brcm/bcm2711/Kconfig"
osource "/home/goaty/Desktop/Tech/zephyr/soc/bflb/Kconfig"
osource "/home/goaty/Desktop/Tech/zephyr/soc/atmel/sam0/Kconfig"
osource "/home/goaty/Desktop/Tech/zephyr/soc/atmel/sam/Kconfig"
osource "/home/goaty/Desktop/Tech/zephyr/soc/aspeed/Kconfig"
osource "/home/goaty/Desktop/Tech/zephyr/soc/arm/Kconfig"
osource "/home/goaty/Desktop/Tech/zephyr/soc/arm/beetle/Kconfig"
osource "/home/goaty/Desktop/Tech/zephyr/soc/antmicro/myra/Kconfig"
osource "/home/goaty/Desktop/Tech/zephyr/soc/andestech/Kconfig"
osource "/home/goaty/Desktop/Tech/zephyr/soc/amd/acp_6_0/Kconfig"
osource "/home/goaty/Desktop/Tech/zephyr/soc/ambiq/Kconfig"
osource "/home/goaty/Desktop/Tech/zephyr/soc/aesc/Kconfig"
osource "/home/goaty/Desktop/Tech/zephyr/soc/adi/max32/Kconfig"
osource "/home/goaty/Desktop/Tech/nrf/soc/sercomm/nrf91/Kconfig"
osource "/home/goaty/Desktop/Tech/nrf/soc/nordic/Kconfig"
```
